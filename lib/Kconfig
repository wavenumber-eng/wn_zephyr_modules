## lib/Kconfig
```kconfig
menu "Custom libraries and modules"

rsource "rt_config/Kconfig"
rsource "data_buf/Kconfig"

endmenu
```

## lib/data_buf/Kconfig
```kconfig
module = DATA_BUG
module-str = data_buf
source "subsys/logging/Kconfig.template.log_config"


config DATA_BUF
	bool "Enable data buffers"
	help
	   Enable data buffers

config DATA_BUF_POOL_BYTES
	int "Size of the data buffer pool in bytes"
	default 10240
	help
	   Size of the data buffer pool in bytes
```

## rt_config/zephyr/Kconfig
```kconfig
# Copyright (c) 2019 Nordic Semiconductor
# SPDX-License-Identifier: Apache-2.0

config RT_CONFIG
	bool "Enable run time configuration macros with NVS storage"
	depends on NVS
	help
	   Enable run time configuration macros with NVS storage
```

## west.yml
```yaml
manifest:
  version: "0.13"

  remotes:


  projects:

    - name: cjson
      repo-path: sdk-cjson
      path: modules/lib/cjson
      revision: c6af068b7f05207b28d68880740e4b9ec1e4b50a
      userdata:
        ncs:
          upstream-url: https://github.com/DaveGamble/cJSON
          upstream-sha: d2735278ed1c2e4556f53a7a782063b31331dbf7
          compare-by-default: false
   
```
