## lib/rt_config/Kconfig
```kconfig
module = RT_CONFIG
module-str = rt_config
source "subsys/logging/Kconfig.template.log_config"

config RT_CONFIG
	bool "Enable RT configurations"

config RT_MAX_ITEMS
	int "Maximum number of runtime configuration items"
	default 64
	range 1 512
	depends on RT_CONFIG
	help
	   Maximum number of RT_CONFIG_ITEM entries the module tracks in its
	   per-item status tables. Increase this when an application defines more
	   than 64 settings.

config RT_CONFIG_VALIDATE_ITEM_COUNT
	bool "Validate RT_CONFIG_ITEM count at build time"
	default y
	depends on RT_CONFIG
	help
	   Fail the build after linking if the number of linked RT_CONFIG_ITEM
	   entries exceeds CONFIG_RT_MAX_ITEMS. This catches table-size mistakes
	   before firmware boots.
	

config RT_CONFIG_USE_NVS
	bool "Enable run time configuration macros with NVS storage"
	select NVS
	select FLASH
	select FLASH_PAGE_LAYOUT
	select SHELL
	select RT_CONFIG
	help
	   Enable run time configuration macros with NVS storage

config RT_CONFIG_USE_FILE
	bool "RT Configurations stored in a file"
	select FLASH
	select FLASH_PAGE_LAYOUT
	select FLASH_MAP
	select DISK_DRIVERS
	select RT_CONFIG
	select FAT_FILESYSTEM_ELM
	select FS_FATFS_LFN
	imply DISK_DRIVER_FLASH
	select FILE_SYSTEM
	select FAT_FILESYSTEM_ELM
	select FS_FATFS_LFN

	help
	   RT Configurations stored in a file
	   This option is used to store the RT Configurations in a file.
	   The file is stored in the USB mass storage device

config RT_CONFIG_FILE_EXPORT_COMMENTS
	bool "Export comment blocks in RT configuration file"
	default y
	depends on RT_CONFIG_USE_FILE
	help
	   Include human-readable setting, description, minimum, and maximum
	   comment lines in the exported RT configuration file. Disable this
	   for a compact name=value file while preserving the same import format.

config RT_CONFIG_FILE_EXPORT_BUFFER_SIZE
	int "RT configuration file export staging buffer size"
	default 1024
	range 256 4096
	depends on RT_CONFIG_USE_FILE
	help
	   Staging buffer size used to coalesce per-item export text into fewer
	   filesystem writes.

config RT_CONFIG_FILE_NAME
	string "File name for automatic RT config load"
    default "rt_config.txt"


config RT_CONFIG_MOUNT_POINT
	string "fat fs mount point for the config file"
    default "/NAND:"
```
